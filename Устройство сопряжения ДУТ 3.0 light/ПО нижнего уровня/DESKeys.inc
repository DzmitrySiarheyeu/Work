//==============================================================================
// File:           DESKeys.inc
// Compiler:       IAR Atmel AVR C/EC++ Compiler
// Output Size:    96
// Created:        12/28/10
//
// Description:    This file is generated by 'create' tool and is to be included
//                 in the 'bootldr' project. It contains a DES key table for
//                 a proper decryption of the file encrypted using the same
//                 configurations.
//
// Keys used:      KEY1 = 529B734668131C5B
//                 KEY2 = N/A
//                 KEY3 = N/A
//==============================================================================


__flash unsigned char kTable[16 * 6] = 
{
	0x80, 0x02, 0xbe, 0xa4, 0xf1, 0xa6,
	0xc1, 0xb8, 0xca, 0x5e, 0x07, 0xb7,
	0x49, 0x9e, 0x21, 0xb2, 0x9e, 0x87,
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	0x30, 0xe6, 0xc2, 0x1f, 0x69, 0xc9
};
